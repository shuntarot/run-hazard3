## nuttx/boards/run-hazard3/configs/nsh/defconfig
```kconfig
# CONFIG_ARCH_BOARD_CUSTOM_DIR_RELPATH is not set
# CONFIG_ARCH_CHIP_CUSTOM_DIR_RELPATH is not set
# CONFIG_NSH_DISABLE_LOSMART is not set
CONFIG_ARCH="risc-v"
CONFIG_ARCH_BOARD_CUSTOM=y
CONFIG_ARCH_BOARD_CUSTOM_DIR="@HERE@/boards/run-hazard3"
CONFIG_ARCH_BOARD_CUSTOM_NAME="run-hazard3"
CONFIG_ARCH_CHIP_CUSTOM_DIR="@HERE@/chips/hazard3"
CONFIG_ARCH_CHIP_CUSTOM_NAME="hazard3"
CONFIG_ARCH_CHIP_RISCV_CUSTOM=y
CONFIG_ARCH_INTERRUPTSTACK=2048
CONFIG_ARCH_RISCV=y
CONFIG_ARCH_STACKDUMP=y
CONFIG_BUILTIN=y
CONFIG_DEBUG_FEATURES=y
CONFIG_DEBUG_FULLOPT=y
CONFIG_DEBUG_SYMBOLS=y
CONFIG_EXAMPLES_HELLO=y
CONFIG_FS_PROCFS=y
CONFIG_FS_TMPFS=y
CONFIG_IDLETHREAD_STACKSIZE=2048
CONFIG_INIT_ENTRYPOINT="nsh_main"
CONFIG_INIT_STACKSIZE=4096
CONFIG_LIBC_PERROR_STDOUT=y
CONFIG_LIBC_STRERROR=y
CONFIG_NSH_BUILTIN_APPS=y
CONFIG_NSH_FILEIOSIZE=512
CONFIG_NSH_READLINE=y
CONFIG_RAM_SIZE=33554432
CONFIG_RAM_START=0x80010000
CONFIG_READLINE_CMD_HISTORY=y
CONFIG_RISCV_TOOLCHAIN_GNU_RV32=y
CONFIG_RR_INTERVAL=200
CONFIG_SCHED_WAITPID=y
CONFIG_SEGGER_RTT_BUFFER_SIZE_UP=4096
CONFIG_SEGGER_RTT_SECTION=".rtt"
CONFIG_SERIAL_RTT0=y
CONFIG_SERIAL_RTT_CONSOLE=y
CONFIG_STACK_COLORATION=y
CONFIG_START_MONTH=10
CONFIG_START_YEAR=2026
CONFIG_SYSTEM_NSH=y
CONFIG_SYSTEM_NSH_STACKSIZE=4096
CONFIG_TESTING_OSTEST=y
CONFIG_USEC_PER_TICK=1000
```
